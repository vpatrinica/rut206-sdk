## Config.in
```kconfig
# SPDX-License-Identifier: GPL-2.0-only
#
# Copyright (C) 2006-2013 OpenWrt.org

mainmenu "OpenWrt Configuration"

config MODULES
	modules
	bool
	default y

config HAVE_DOT_CONFIG
	bool
	default y

source "target/Config.in"

source "config/Config-brand.in"

source "config/Config-options.in"

if !BUILD_MINIMAL_IMAGE
source "config/Config-tlt.in"
endif

source "config/Config-tweaks.in"

source "config/Config-images.in"

source "config/Config-gpl.in"

source "config/Config-build.in"

source "config/Config-devel.in"

source "toolchain/Config.in"

source "target/linux/*/Config.in"

source "target/imagebuilder/Config.in"

source "target/sdk/Config.in"

source "target/toolchain/Config.in"

source "tmp/.config-package.in"

if BUILD_FACTORY_TEST_IMAGE
source "target/linux/*/Config-factory.in"
endif
```

## package/boot/uboot-mt7621/src/drivers/clk/qti/Kconfig
```kconfig
config CLK_IPQ5332
	depends on DM && PINCTRL_QTI && TARGET_IPQ5332
	default y
	bool "Clock controller driver for QTI IPQ5332"
	help
	  Enable this to support the clocks on IPQ5332 SoCs.
```

## package/boot/uboot-mt7621/src/drivers/net/qti/Kconfig
```kconfig
config ETH_IPQ5332
	depends on DM && QTI_NSS_SWITCH && TARGET_IPQ5332
	default y
	bool "Ethernet driver for QTI IPQ5332"
	help
	  Enable this to support the ethernet in IPQ5332 SoCs.
```

## package/boot/uboot-mt7621/src/failsafe/Kconfig
```kconfig
#
# Failsafe Web UI
#

menuconfig WEBUI_FAILSAFE
	bool "Enable Failsafe Web UI"
	select TCP
	select HTTPD
	default y
	help
	  Enable Web based failsafe UI

if WEBUI_FAILSAFE

config WEBUI_FAILSAFE_ON_AUTOBOOT_FAIL
	bool "Start Failsafe Web UI on autoboot failure"
	default y

config WEBUI_FAILSAFE_LEGACY
	bool "Disable failsafe mechanism and default to firmware partition"
	default n

endif # WEBUI_FAILSAFE
```

## package/feeds/vuci/api-core/Config.in
```kconfig
menu "Configuration"
	depends on PACKAGE_api-core

	config VUCI_COMPILE_LUA
		bool "Compile lua files"
		depends on PACKAGE_api-core

	config VUCI_MINIFY_LUA
		bool "Minify lua files"
		depends on PACKAGE_api-core
		default y
endmenu
```

## package/feeds/vuci/vuci-ui-core/Config.in
```kconfig
menu "Configuration"
	depends on PACKAGE_vuci-ui-core

	config VUCI_BUILD_DEV
	bool "Build for development"
	default n
	depends on PACKAGE_vuci-ui-core
	help
	  This turn on development mode. During development, Vue provides
	  a lot of warnings to help you with common errors and pitfalls.

	config VUCI_MINIFY_JSON
	bool "Minify json files"
	default y
	depends on PACKAGE_vuci-ui-core

	choice
		prompt "Node compiler config"
		default VUCI_USE_HOST_NODE

		config VUCI_USE_HOST_NODE
			bool "Host Node"
			help
				This option select host installled node compile vuejs 

	endchoice

	config VUCI_NODE_EXTRA_BIN_PATH
		string "Extra path to nodejs binaries"
		help
			Specify a different path to nodejs binaries, in case they are not in /usr/bin or /usr/local/bin
		depends on VUCI_USE_HOST_NODE
	
endmenu
```

## package/system/rpcd/Config.in
```kconfig
if PACKAGE_rpcd

comment "Settings"

config RPCD_PAM
	bool "Enable PAM support"
	default n

config RPCD_2FA
	bool "Enable 2FA support"
	default n

comment "Plugins"

endif
```

## package/system/uci/Config.in
```kconfig
if PACKAGE_libuci

config UCI_LOG_SUPPORT
	bool "Enable UCI logging support"
	default y if !BUILD_MINIMAL_IMAGE

endif
```

## package/teltonika/cypress-serial/Config.in
```kconfig
if PACKAGE_kmod-cypress-serial

config CYPRESS_SERIAL_MODPARAMS
	string "Default cypress usb to serial converter module arguments"
	default "path_only=1-1.3" if DEFAULT_kmod-cypress-serial
	default "cdc=y"

endif
```

## package/teltonika/data_sender/Config.in
```kconfig
config PACKAGE_DATA_SENDER_DEBUG
	bool "Enable debug"
	depends on PACKAGE_data-sender
	default n
    help
        Enables deep debuging

menu "Advanced options"
	depends on PACKAGE_data-sender

config PACKAGE_DATA_SENDER_COLLECTIONS
    int "Maximum number of collections supported"
    default 20
    help
        Maximum number of collections supported

config PACKAGE_DATA_SENDER_INPUTS
    int "Maximum inputs per collection"
    default 10 
    help
        Maximum number of inputs per collection supported

endmenu

menu "Encoders"
	depends on PACKAGE_data-sender

config PACKAGE_DATA_SENDER_BASE64
	bool "base64 encoder"
	default n
    help
        Compile with base64 encoder

endmenu

menu "Timers"
	depends on PACKAGE_data-sender

config PACKAGE_DATA_SENDER_SCHEDULER
	bool "scheduler support"
	default n
    help
        Compile with scheduler support

endmenu
```

## package/teltonika/event_juggler/Config.in
```kconfig
config PACKAGE_EVENT_JUGGLER_DEBUG
	bool "Enable debug"
	depends on PACKAGE_event-juggler
	default n
    help
        Enables deep debuging

menu "Events"
	depends on PACKAGE_event-juggler

config PACKAGE_EVENT_JUGGLER_EVENT_IO
	bool "IO event support"
	default n
    help
        Compile with IO event support

config PACKAGE_EVENT_JUGGLER_EVENT_LOG
	bool "Log event support"
	default y
	help
		Compile with log event support

config PACKAGE_EVENT_JUGGLER_EVENT_QUOTA
	bool "Data limit event support"
	default n
	help
		Compile with data limit event support

config PACKAGE_EVENT_JUGGLER_EVENT_GPS
	bool "GPS event support"
	default n
	help
		Compile with GPS event support

config PACKAGE_EVENT_JUGGLER_EVENT_GSM
	bool "GSM event support"
	default n
	help
		Compile with GSM event support

config PACKAGE_EVENT_JUGGLER_EVENT_ASTRO_TIME
	bool "Astronomic time event support"
	default y
	help
		Compile with astronomic time event support

config PACKAGE_EVENT_JUGGLER_EVENT_BOOT
	bool "Boot event support"
	default y
	help
		Compile with boot event support

config PACKAGE_EVENT_JUGGLER_EVENT_TIME
	bool "Cronjob style event support"
	default y
	help
		Compile with cronjob style event support

config PACKAGE_EVENT_JUGGLER_EVENT_HOTSPOT
	bool "Hotspot event support"
	default y
	help
		Compile with hotspot event support

config PACKAGE_EVENT_JUGGLER_EVENT_DUMMY
	bool "Dummy event support"
	default n
	help
		Compile with dummy event support

endmenu

menu "Actions"
	depends on PACKAGE_event-juggler

config PACKAGE_EVENT_JUGGLER_ACTION_REBOOT
	bool "Reboot action support"
	default y
	help
		Compile with reboot action support

config PACKAGE_EVENT_JUGGLER_ACTION_OUT
	bool "IO action support"
	default n
	help
		Compile with IO action support

config PACKAGE_EVENT_JUGGLER_ACTION_WIFI
	bool "Wifi action support"
	default n
	help
		Compile with wifi action support

config PACKAGE_EVENT_JUGGLER_ACTION_PROFILE
	bool "Profile action support"
	default y
	help
		Compile with profile action support

config PACKAGE_EVENT_JUGGLER_ACTION_RMS
	bool "RMS action support"
	default y
	help
		Compile with RMS action support

config PACKAGE_EVENT_JUGGLER_ACTION_SHUTDOWN
	bool "Shutdown action support"
	default y
	help
		Compile with shutdown action support

config PACKAGE_EVENT_JUGGLER_ACTION_EXEC
	bool "Exec action support"
	default y
	help
		Compile with exec action support

config PACKAGE_EVENT_JUGGLER_ACTION_MODEM
	bool "Modem action support"
	default n
	help
		Compile with modem action support

config PACKAGE_EVENT_JUGGLER_ACTION_LUA
	bool "LUA action support"
	default y
	help
		Compile with LUA action support

config PACKAGE_EVENT_JUGGLER_ACTION_SIM_SWITCH
	bool "SIM switch action support"
	default n
	help
		Compile with SIM switch action support

config PACKAGE_EVENT_JUGGLER_ACTION_HTTP
	bool "HTTP action support"
	default y
	help
		Compile with HTTP action support

config PACKAGE_EVENT_JUGGLER_ACTION_SMS
	bool "SMS action support"
	default n
	help
		Compile with SMS action support

config PACKAGE_EVENT_JUGGLER_ACTION_CALL
	bool "Call action support"
	default n
	help
		Compile with Call action support`

config PACKAGE_EVENT_JUGGLER_ACTION_SMTP
	bool "SMTP action support"
	default y
	help
		Compile with SMTP action support

config PACKAGE_EVENT_JUGGLER_ACTION_MQTT
	bool "MQTT action support"
	default y
	help
		Compile with MQTT action support

config PACKAGE_EVENT_JUGGLER_ACTION_CONNECTION
	bool "Connection control support"
	default y
	help
		Compile with connection control support

config PACKAGE_EVENT_JUGGLER_ACTION_LED
	bool "LED control support"
	default y
	help
		Compile with LED control support

endmenu

menu "Conditions"
	depends on PACKAGE_event-juggler

config PACKAGE_EVENT_JUGGLER_CONDITION_TIME
	bool "Time condition support"
	default y
	help
		Compile with time condition support

config PACKAGE_EVENT_JUGGLER_CONDITION_BOOL
	bool "Boolean condition support"
	default y
	help
		Compile with boolean condition support

config PACKAGE_EVENT_JUGGLER_CONDITION_IO
	bool "I/O condition support"
	default n
	help
		Compile with I/O condition support

config PACKAGE_EVENT_JUGGLER_CONDITION_GPS
	bool "GPS condition support"
	default n
	help
		Compile with GPS condition support

config PACKAGE_EVENT_JUGGLER_CONDITION_LUA
	bool "LUA condition support"
	default y
	help
		Compile with LUA condition support

config PACKAGE_EVENT_JUGGLER_CONDITION_FILTER
	bool "Filter condition support"
	default y
	help
		Compile with filter condition support

endmenu
```

## package/teltonika/ip_blockd/Config.in
```kconfig
config IP_BLOCKD_MAC_SUPPORT
    bool "MAC blocking support"
    depends on PACKAGE_ip_blockd
    default n
    help
        Enables MAC blocking support
```

## package/teltonika/mobifd/Config.in
```kconfig
config MOBIFD_DEBUG
	bool "Enable debuging"
	depends on PACKAGE_mobifd
	default n
    help
        Enables deep debuging
```

## package/teltonika/mobutils/Config.in
```kconfig
menu "Advanced settings"
	depends on PACKAGE_mobutils

config MOBILE_UTILS_TEST
	bool "Test mode"
	default n
    help
        Compile with test mode

endmenu
```

## package/teltonika/site_manager/Config.in
```kconfig
# Site manager client side configuration

menu "Advanced configuration"
	depends on PACKAGE_siteman_client

config SITEMANC_DEBUG
    bool "Include extended debug messages"
    default n
    help
        include extended debug messages

endmenu

menu "Discovery methods"
	depends on PACKAGE_siteman_client

config SITEMANC_DISCOVERY_CUSTOM
	bool "HTTP"
	default n
	help
		Discover site manager address using HTTP request

config SITEMANC_DISCOVERY_DHCP
	bool "DHCP"
	default y
    help
        Discover site manager address using DHCP option 43

config SITEMANC_DISCOVERY_DNS
    bool "DNS"
    default y
    help
        Discover site manager address using DNS

config SITEMANC_DISCOVERY_RADIUS
    bool "Radius"
    default n
    help
        Discover site manager address using Radius server

config SITEMANC_DISCOVERY_STATIC
    bool "Static"
    default y
    help
        Use static address for site manager

config SITEMANC_DISCOVERY_TLT
    bool "TLTDP"
    default y
    help
        Discover site manager address using Teltonika discovery protocol (tltdp)

endmenu
```

## target/Config.in
```kconfig
source "tmp/.config-target.in"

# Kernel/Hardware features

config HAS_TESTING_KERNEL
	bool

config HAS_SPE_FPU
	depends on powerpc
	select HAS_FPU
	bool

config HAS_FPU
	bool

config AUDIO_SUPPORT
	bool

config GPIO_SUPPORT
	bool

config PCI_SUPPORT
	bool

config PCIE_SUPPORT
	bool

config PCMCIA_SUPPORT
	bool

config PWM_SUPPORT
	bool

config USB_SUPPORT
	bool

config USB_GADGET_SUPPORT
	bool

config RTC_SUPPORT
	bool

config BIG_ENDIAN
	bool

config USES_DEVICETREE
	bool

config USES_INITRAMFS
	bool

config USES_SQUASHFS
	bool

config USES_JFFS2
	bool

config USES_JFFS2_NAND
	bool

config USES_EXT4
	bool

config USES_TARGZ
	bool

config USES_CPIOGZ
	bool

config USES_MINOR
	bool

config USES_UBIFS
	bool
	select NAND_SUPPORT

config LOW_MEMORY_FOOTPRINT
	bool

config SMALL_FLASH
	bool

config NOMMU
	bool

config HAS_MIPS16
	depends on (mips || mipsel || mips64 || mips64el)
	bool

config RFKILL_SUPPORT
	bool

config WPS_SUPPORT
	bool

config NAND_SUPPORT
	bool

config ARCH_64BIT
	bool

config VIRTIO_SUPPORT
	bool

config BASEBAND_SUPPORT
	bool

config PPP_MOBILE_SUPPORT
	bool

config BYPASS_OFFLOAD_FEATURE
	bool

config HAVE_QRTR_PIPE_ENDPOINTS
	bool

config VERIFIED_BOOT_SUPPORT
	bool

config USES_ROOTFS_PART
	bool

config USES_BOOT_PART
	bool

config USB_SUPPORT_EXTERNAL
	bool
	imply SERIAL_SUPPORT

config HAS_SINGLE_ETH_PORT
	bool

config HAS_IO
	bool

config HAS_DOT1X_CLIENT
	bool

config HAS_DOT1X_SERVER
	bool

config HAS_POWER_CONTROL
	bool

config HAS_MODBUS
	bool

config HAS_DOWNSTREAM_KERNEL
	bool

config CUSTOM_DATA_LIMIT
	bool

config SMP_SUPPORT
	bool

config DSA_SUPPORT
	bool

config HAS_PORT_MIRRORING
	bool

config USES_SOFT_PORT_MIRROR
	bool

config USES_VENDOR_WIFI_DRIVER
	bool

config MT7981_WIFI
	bool

config BASIC_ROUTER
	bool

config MULTI_DEVICE_QUIRK
	bool

config HIGH_WATCHDOG_PRIORITY
	bool
	default y

config AP_DEVICE
	bool

config LEDMAN_LITE
	bool

config ETHTOOL_TINY
	bool

config GATEWAY_DEVICE
	bool

config 64MB_RAM
	bool

config 128MB_RAM
	bool
	
config SW_OFFLOAD
	bool

config HW_OFFLOAD
	bool

config XFRM_OFFLOAD
	bool

config MODEM_RESET_QUIRK
	bool

config PORT_LINK
	bool

config HAS_RS232
	bool
	imply SERIAL_SUPPORT

config HAS_RS485
	bool
	imply SERIAL_SUPPORT

config HIGH_STORAGE
	bool

config INDUSTRIAL_AP
	bool

config EMMC_SUPPORT
	bool

config NO_WIRED_WAN
	bool

config TEST_IMAGE
	bool

config CONSUMER_AP
	bool

# Architecture selection

config aarch64
	select ARCH_64BIT
	bool

config aarch64_be
	select ARCH_64BIT
	select BIG_ENDIAN
	bool

config arc
	bool

config arceb
	select BIG_ENDIAN
	bool

config arm
	bool

config armeb
	select BIG_ENDIAN
	bool

config arm_v6
	bool

config arm_v7
	bool

config i386
	bool

config i686
	bool

config m68k
	bool

config mips
	select BIG_ENDIAN
	bool

config mipsel
	bool

config mips64
	select BIG_ENDIAN
	select ARCH_64BIT
	bool

config mips64el
	select ARCH_64BIT
	bool

config powerpc
	select BIG_ENDIAN
	bool

config powerpc64
	select BIG_ENDIAN
	select ARCH_64BIT
	bool

config sh3
	bool

config sh3eb
	select BIG_ENDIAN
	bool

config sh4
	bool

config sh4eb
	select BIG_ENDIAN
	bool

config sparc
	select BIG_ENDIAN
	bool

config x86_64
	select ARCH_64BIT
	bool

config ARCH
	string
	default "aarch64"   if aarch64
	default "aarch64_be" if aarch64_be
	default "arc"       if arc
	default "arceb"     if arceb
	default "arm"       if arm
	default "armeb"     if armeb
	default "i386"      if i386
	default "i686"      if i686
	default "m68k"      if m68k
	default "mips"      if mips
	default "mipsel"    if mipsel
	default "mips64"    if mips64
	default "mips64el"  if mips64el
	default "powerpc"   if powerpc
	default "powerpc64" if powerpc64
	default "sh3"       if sh3
	default "sh3eb"     if sh3eb
	default "sh4"       if sh4
	default "sh4eb"     if sh4eb
	default "sparc"     if sparc
	default "x86_64"    if x86_64

config RESET_BUTTON_SUPPORT
	bool

config NETWORKS_EXTERNAL
	bool
```

## target/linux/generic/files/drivers/sysfs-mnfinfo/Kconfig
```kconfig
config SYSFS_MNFINFO
	bool "Mnfinfo via sysfs"
	default y
	help
	  This provides a ability to read device RO metadata via sysfs.

config MNF_TEST
	bool "sysfs_mnfinfo test image option"
	default n
	depends on SYSFS_MNFINFO=y
	help
	  This adds additional dummy RO MNF fields for testing image.
```

## target/linux/ramips/Config.in
```kconfig
menu "Target options and settings"
depends on TARGET_ramips_mt7621

config DEFAULT_TARGET_OPTIONS
	bool
	default y
	select KERNEL_MTD_UBI
	select KERNEL_MTD_UBI_BLOCK
	select PACKAGE_crconf
	select PACKAGE_kmod-crypto-user

endmenu
```

## target/linux/ramips/image/Config.in
```kconfig
config BUILD_BOOTLOADER
	bool
	depends on BUILD_FACTORY_IMAGE && TARGET_ramips
	select PACKAGE_uboot-ath79 if TARGET_ramips_mt76x8 && SMALL_FLASH
	select PACKAGE_uboot-mt7621 if TARGET_ramips_mt7621 || \
		(TARGET_ramips_mt76x8 && !SMALL_FLASH)
```
